#include  <Arduino.h>
class game1
{
  public:
    byte contral=0;//哪隻搖桿控制
    byte cursor[2]={0};//游標位置y,x
    bool flag[2][6][6]=//[0:圈 1:叉]
    {{{0,0,1,1,0,0},
      {0,1,0,0,1,0},
      {1,0,0,0,0,1},
      {1,0,0,0,0,1},
      {0,1,0,0,1,0},
      {0,0,1,1,0,0}
    },
    {{1,0,0,0,0,1},
    {0,1,0,0,1,0},
    {0,0,1,1,0,0},
    {0,0,1,1,0,0},
    {0,1,0,0,1,0},
    {1,0,0,0,0,1}
    }};
    bool map[20][20]=//顯示地圖
    {{0,0,0,0,0,0,1,0,0,0,0,0,0,1,0,0,0,0,0,0},
     {0,0,0,0,0,0,1,0,0,0,0,0,0,1,0,0,0,0,0,0},
     {0,0,0,0,0,0,1,0,0,0,0,0,0,1,0,0,0,0,0,0},
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     {0,0,0,0,0,0,1,0,0,0,0,0,0,1,0,0,0,0,0,0}
    };
    bool round=0;//回合0:玩家0(圈圈) 1:玩家1(叉叉)
    const int color[2]={256*256*255,256*256*126+126};//[0:現在顏色 1:圈圈顏色(藍) 2:叉叉顏色(紫)]
    bool stat[8]={0};//第一~三列,第一~三行,左上右下,由上左下,總狀態
    byte stat_all=0;//總狀態
    byte choose_log[3][3]={0};//紀錄誰選擇什麼位置0:未選擇 1:圈圈選擇 2:叉叉選擇
    int tie=0;
    void initialize()
    {
      byte i,f;
      tie=0;
      round=0;
      cursor[0]=0;
      cursor[1]=0;
      for(i=0;i<3;i++)
      {
        for(f=0;f<3;f++)
        {
          choose_log[i][f]=0;
        }
      }
    }
    void choose(byte y,byte x)//選擇位置 回傳值0:選擇成功 1:選擇失敗 2:有玩家獲勝
    {
      byte i,f;
      stat_all=1;
      if(y>-1&&y<3&&x>-1&&x<3&&choose_log[y][x]==0)//選擇位置為未被選
      {
        choose_log[y][x]=round+1;
        tie++;
        for(i=0;i<8;i++)
        {
          stat[i]=1;
        }
        for(i=0;i<3;i++)
        {
          for(f=0;f<3;f++)
          {
            if(choose_log[i][f]!=round+1)
            {
              stat[i]=0;//刪列
              stat[f+3]=0;//刪行
              if(i==f)//刪左上右下
              {
                stat[6]=0;
              }
              if(i+f==2)//刪右上左下
              {
                stat[7]=0;
              }
            }
          }
        }
        if(tie==9)//判斷為平手
        {
          stat_all=3;
          return;
        }
        for(i=0;i<8;i++)
        {
          if(stat[i]==1)//判斷為當前玩家贏
          {
            stat_all=2;
          }
        }
        if(stat_all!=2)//選擇成功
        {
          stat_all=0;
        }
      }
    }
};